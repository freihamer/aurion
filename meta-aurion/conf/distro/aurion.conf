## meta-aurion/conf/distro/aurion.conf
```bitbake
INHERIT += "version-git-describe"

DISTRO = "aurion"
DISTRO_NAME = "Aurion Yocto Distribution"
DISTRO_VERSION := "${VERSION_GIT_DESCRIBE}"

SDK_VENDOR = "-aurion"
SDK_NAME = "Aurion SDK"
SDK_VERSION = "${DISTRO_VERSION}"

DISTRO_FEATURES:append = " systemd ssh-server-dropbear usrmerge"

VIRTUAL-RUNTIME_init_manager = "systemd"
VIRTUAL-RUNTIME_initscripts = ""

# Package formats
PACKAGE_CLASSES = "package_ipk"

PREFERRED_PROVIDER_ssh-server = "dropbear"
```

## meta-aurion/conf/layer.conf
```bitbake
# We have a conf and classes directory, add to BBPATH
BBPATH .= ":${LAYERDIR}"

# We have recipes-* directories, add to BBFILES
BBFILES += "${LAYERDIR}/recipes-*/*/*.bb \
            ${LAYERDIR}/recipes-*/*/*.bbappend"

BBFILE_COLLECTIONS += "meta-aurion"
BBFILE_PATTERN_meta-aurion = "^${LAYERDIR}/"
BBFILE_PRIORITY_meta-aurion = "6"

LAYERDEPENDS_meta-aurion = "core"
LAYERSERIES_COMPAT_meta-aurion = "kirkstone"
```

## meta-hypersonica/conf/distro/hypersonica.conf
```bitbake
INHERIT += "version-git-describe"

DISTRO = "hypersonica"
DISTRO_NAME = "Hypersonica Yocto Distribution"
DISTRO_VERSION := "${VERSION_GIT_DESCRIBE}"

SDK_VENDOR = "-hypersonica"
SDK_VERSION = "${DISTRO_VERSION}"

DISTRO_FEATURES:append = " systemd ssh-server-dropbear usrmerge"

VIRTUAL-RUNTIME_init_manager = "systemd"
VIRTUAL-RUNTIME_initscripts = ""

# Package formats
PACKAGE_CLASSES = "package_ipk"

PREFERRED_PROVIDER_ssh-server = "dropbear"
```

## meta-hypersonica/conf/layer.conf
```bitbake
# We have a conf and classes directory, add to BBPATH
BBPATH .= ":${LAYERDIR}"

# We have recipes-* directories, add to BBFILES
BBFILES += "${LAYERDIR}/recipes-*/*/*.bb \
            ${LAYERDIR}/recipes-*/*/*.bbappend"

BBFILE_COLLECTIONS += "meta-hypersonica"
BBFILE_PATTERN_meta-hypersonica = "^${LAYERDIR}/"
BBFILE_PRIORITY_meta-hypersonica = "6"

LAYERDEPENDS_meta-hypersonica = "core"
LAYERSERIES_COMPAT_meta-hypersonica = "scarthgap"
```

## meta-hypersonica/meta-platform/conf/machine/fcc-generic.conf
```bitbake
#@TYPE: Machine
#@NAME: fcc-generic
#@SOC: Polarfire SoC
#@DESCRIPTION: Machine configuration for the Flight Control Computer

MACHINEOVERRIDES =. "${@['', 'fcc-generic:']['fcc-generic' != '${MACHINE}']}"

require conf/machine/me-mp1-250-si-d3en.conf
```

## meta-hypersonica/meta-platform/conf/machine/fcc-v1.conf
```bitbake
#@TYPE: Machine
#@NAME: fcc-v1
#@SOC: Polarfire SoC
#@DESCRIPTION: Machine configuration for the Flight Control Computer v1

MACHINEOVERRIDES =. "${@['', 'fcc-v1:']['fcc-v1' != '${MACHINE}']}"

require conf/machine/fcc-generic.conf

WKS_FILE ?= "enclustra-mercury-mp1.wks"
IMAGE_FSTYPES:append = " wic wic.gz"

## Do not update fstab file when using wic images
WIC_CREATE_EXTRA_ARGS ?= "--no-fstab-update"

WKS_FILE_DEPENDS ?= " \
    u-boot-mchp \
    e2fsprogs-native \
    bmap-tools-native \
"

IMAGE_BOOT_FILES ?= " \
    fitImage \
    boot.scr \
"
```
